## firmware/boards/shields/roard/Kconfig.defconfig
```kconfig
if SHIELD_ROARD_DONGLE

config ZMK_KEYBOARD_NAME
    default "roard"

config ZMK_SPLIT_ROLE_CENTRAL
    default y

config ZMK_SPLIT
    default y

config ZMK_SPLIT_BLE_CENTRAL_PERIPHERALS
    default 2

config ZMK_STUDIO
    default y

endif # SHIELD_ROARD_DONGLE

if SHIELD_ROARD_LEFT || SHIELD_ROARD_RIGHT

config ZMK_SPLIT
    default y

endif # SHIELD_ROARD_LEFT || SHIELD_ROARD_RIGHT
```

## firmware/boards/shields/roard/Kconfig.shield
```kconfig
config SHIELD_ROARD_LEFT
    def_bool $(shields_list_contains,roard_left)

config SHIELD_ROARD_RIGHT
    def_bool $(shields_list_contains,roard_right)

config SHIELD_ROARD_DONGLE
    def_bool $(shields_list_contains,roard_dongle)
```
